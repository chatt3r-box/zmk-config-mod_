## config/boards/arm/mod_/Kconfig
```kconfig
#
# copyright (c) 2025 ZMK project contributors
# SPDX-license-identifier: MIT
#

config BOARD_MOD_MN_L
    bool

config BOARD_MOD_MN_R
    bool

config BOARD_MOD_FN_L
    bool

config BOARD_MOD_FN_R
    bool

config BOARD_MOD_NP
    bool

config BOARD_MOD_XT
    bool
```

## config/boards/arm/mod_/Kconfig.board
```kconfig
#
# copyright (c) 2025 ZMK project contributors
# SPDX-license-identifier: MIT
#

config BOARD_MOD_MN_L
    bool "mod_mn_l"
    depends on SOC_NRF52833_QIAA

config BOARD_MOD_MN_R
    bool "mod_mn_r"
    depends on SOC_NRF52833_QIAA

config BOARD_MOD_FN_L
    bool "mod_fn_l"
    depends on SOC_NRF52833_QIAA

config BOARD_MOD_FN_R
    bool "mod_fn_r"
    depends on SOC_NRF52833_QIAA

config BOARD_MOD_NP
    bool "mod_np"
    depends on SOC_NRF52833_QIAA

config BOARD_MOD_XT
    bool "mod_xt"
    depends on SOC_NRF52833_QIAA

#config CAPS_LOCK_LED
#    bool "caps_lock_led"
#
#config NUMS_LOCK_LED
#    bool "num_lock_led"
#
#config SCROLL_LOCK_LED
#    bool "scroll_lock_led"
```

## config/boards/arm/mod_/Kconfig.defconfig
```kconfig
#
# copyright (c) 2025 ZMK project contributors
# SPDX-license-identifier: MIT
#

if BOARD_MOD_MN_L

config ZMK_KEYBOARD_NAME
    default "mod_"

config ZMK_SPLIT_ROLE_CENTRAL
    default y

endif # BOARD_MOD_MN_L


if BOARD_MOD_MN_L || BOARD_MOD_MN_R

config I2C
    default y

config MAX17048
    default y

endif # BOARD_MOD_MN_L || BOARD_MOD_MN_R


if BOARD_MOD_MN_L || BOARD_MOD_MN_R || BOARD_MOD_FN_L || BOARD_MOD_FN_R || BOARD_MOD_NP || BOARD_MOD_XT

config BOARD
    default "mod_"

config ZMK_SPLIT
    default y

config BT_CTLR
    default BT

config ZMK_BLE
	default y

config CAPS_LOCK_LED
    bool "caps_lock_led"
    default n

if USB

config USB_NRFX
    default y

config USB_DEVICE_STACK
    default y

config ZMK_USB
	default y

endif # USB

endif # BOARD_MOD_MN_L || BOARD_MOD_MN_R || BOARD_MOD_FN_L || BOARD_MOD_FN_R || BOARD_MOD_NP || BOARD_MOD_XT
```

## config/boards/arm/mod_/mod_fn_r_defconfig
```kconfig
#
# copyright (c) 2025 ZMK project contributors
# SPDX-license-identifier: MIT
#

# identify MCU and board
CONFIG_SOC_SERIES_NRF52X=y
CONFIG_SOC_NRF52833_QIAA=y
CONFIG_BOARD_MOD_FN_R=y

# enable MPU
CONFIG_ARM_MPU=y

# enable writing to flash
CONFIG_USE_DT_CODE_PARTITION=y
CONFIG_BUILD_OUTPUT_UF2=y
CONFIG_MPU_ALLOW_FLASH_WRITE=y
CONFIG_NVS=y
CONFIG_SETTINGS_NVS=y
CONFIG_FLASH=y
CONFIG_FLASH_PAGE_LAYOUT=y
CONFIG_FLASH_MAP=y

# enable 32kHz crystal
CONFIG_CLOCK_CONTROL_NRF_K32SRC_XTAL=y
CONFIG_CLOCK_CONTROL_NRF_K32SRC_30PPM=y

# GPIO
CONFIG_GPIO=y
CONFIG_PINCTRL=y

# SCROLL LOCK (SK6812MINI-E RGB LED)
CONFIG_ZMK_RGB_UNDERGLOW=y
CONFIG_WS2812_STRIP=y

# enable SPI
CONFIG_SPI=y

# USB & BLE
CONFIG_ZMK_USB=y
CONFIG_ZMK_BLE=y

# # weak bond for better battery life on mn.l
# CONFIG_ZMK_SPLIT_BLE_PREF_WEAK_BOND=y

# # uncomment to enable USB logging & debugging
# CONFIG_ZMK_USB_LOGGING=y
# CONFIG_ZMK_LOG_LEVEL_DBG=y
# CONFIG_I2C_LOG_LEVEL_DBG=y
# CONFIG_LOG_PROCESS_THREAD_STARTUP_DELAY_MS=8000
```

## config/boards/arm/mod_/mod_mn_l_defconfig
```kconfig
#
# copyright (c) 2025 ZMK project contributors
# SPDX-license-identifier: MIT
#

# identify MCU and board
CONFIG_SOC_SERIES_NRF52X=y
CONFIG_SOC_NRF52833_QIAA=y
CONFIG_BOARD_MOD_MN_L=y

# enable MPU
CONFIG_ARM_MPU=y

# enable writing to flash
CONFIG_USE_DT_CODE_PARTITION=y
CONFIG_BUILD_OUTPUT_UF2=y
CONFIG_MPU_ALLOW_FLASH_WRITE=y
CONFIG_NVS=y
CONFIG_SETTINGS_NVS=y
CONFIG_FLASH=y
CONFIG_FLASH_PAGE_LAYOUT=y
CONFIG_FLASH_MAP=y

# enable 32kHz crystal
CONFIG_CLOCK_CONTROL_NRF_K32SRC_XTAL=y
CONFIG_CLOCK_CONTROL_NRF_K32SRC_30PPM=y

# GPIO
CONFIG_GPIO=y
CONFIG_PINCTRL=y

# encoder
CONFIG_EC11=y
CONFIG_EC11_TRIGGER_GLOBAL_THREAD=y

# CAPS LOCK (SK6812MINI-E RGB LED)
CONFIG_ZMK_RGB_UNDERGLOW=y
CONFIG_WS2812_STRIP=y

# enable SPI
CONFIG_SPI=y

# enable I2C
CONFIG_I2C=y
CONFIG_I2C_NRFX=y

# USB & BLE
CONFIG_ZMK_USB=y
CONFIG_ZMK_BLE=y

# battery reporting
CONFIG_BT_GATT_ENFORCE_SUBSCRIPTION=y
CONFIG_ZMK_BATTERY_REPORTING=y

# force battery reporting from peripherals splits to central split
CONFIG_ZMK_SPLIT_BLE_CENTRAL_BATTERY_LEVEL_FETCHING=y
CONFIG_ZMK_SPLIT_BLE_CENTRAL_BATTERY_LEVEL_PROXY=y
CONFIG_ZMK_SPLIT_BLE_CENTRAL_BATTERY_LEVEL_QUEUE_SIZE=1

# max number of peripheral splits connected to central split
CONFIG_ZMK_SPLIT_BLE_CENTRAL_PERIPHERALS=5

# status indicator (standard RGB LED)
CONFIG_ZMK_HID_INDICATORS=y
CONFIG_LED=y
CONFIG_CAPS_LOCK_LED=y
CONFIG_ZMK_RGB_UNDERGLOW_EXT_POWER=n
CONFIG_RGBLED_WIDGET=y
CONFIG_RGBLED_WIDGET_BATTERY_LEVEL_LOW=10

# weak bond for better battery life on mn.l
CONFIG_ZMK_SPLIT_BLE_PREF_WEAK_BOND=y

# timer to suspend continuous scanning extra peripherals within 30 seconds once any peripheral is connected
CONFIG_ZMK_SPLIT_BLE_PREF_CONTINUOUS_SCAN_WINDOW=30000 

# # uncomment to enable USB logging & debugging
# CONFIG_ZMK_USB_LOGGING=y
# CONFIG_ZMK_LOG_LEVEL_DBG=y
# CONFIG_I2C_LOG_LEVEL_DBG=y
```

## config/boards/arm/mod_/mod_mn_r_defconfig
```kconfig
#
# copyright (c) 2025 ZMK project contributors
# SPDX-license-identifier: MIT
#

# identify MCU and board
CONFIG_SOC_SERIES_NRF52X=y
CONFIG_SOC_NRF52833_QIAA=y
CONFIG_BOARD_MOD_MN_R=y

# enable MPU
CONFIG_ARM_MPU=y

# enable writing to flash
CONFIG_USE_DT_CODE_PARTITION=y
CONFIG_BUILD_OUTPUT_UF2=y
CONFIG_MPU_ALLOW_FLASH_WRITE=y
CONFIG_NVS=y
CONFIG_SETTINGS_NVS=y
CONFIG_FLASH=y
CONFIG_FLASH_PAGE_LAYOUT=y
CONFIG_FLASH_MAP=y

# enable 32kHz crystal
CONFIG_CLOCK_CONTROL_NRF_K32SRC_XTAL=y
CONFIG_CLOCK_CONTROL_NRF_K32SRC_30PPM=y

# GPIO
CONFIG_GPIO=y
CONFIG_PINCTRL=y

# encoder
CONFIG_EC11=y
CONFIG_EC11_TRIGGER_GLOBAL_THREAD=y

# Enable I2C
CONFIG_I2C=y
CONFIG_I2C_NRFX=y

# USB & BLE
CONFIG_ZMK_USB=n
CONFIG_ZMK_BLE=y

# battery reporting
CONFIG_BT_GATT_ENFORCE_SUBSCRIPTION=y
CONFIG_ZMK_BATTERY_REPORTING=y
```

## config/boards/arm/mod_/mod_np_defconfig
```kconfig
#
# copyright (c) 2025 ZMK project contributors
# SPDX-license-identifier: MIT
#

# identify MCU and board
CONFIG_SOC_SERIES_NRF52X=y
CONFIG_SOC_NRF52833_QIAA=y
CONFIG_BOARD_MOD_NP=y

# enable MPU
CONFIG_ARM_MPU=y

# enable writing to flash
CONFIG_USE_DT_CODE_PARTITION=y
CONFIG_BUILD_OUTPUT_UF2=y
CONFIG_MPU_ALLOW_FLASH_WRITE=y
CONFIG_NVS=y
CONFIG_SETTINGS_NVS=y
CONFIG_FLASH=y
CONFIG_FLASH_PAGE_LAYOUT=y
CONFIG_FLASH_MAP=y

# enable 32kHz crystal
CONFIG_CLOCK_CONTROL_NRF_K32SRC_XTAL=y
CONFIG_CLOCK_CONTROL_NRF_K32SRC_30PPM=y

# GPIO
CONFIG_GPIO=y
CONFIG_PINCTRL=y

# num lock
CONFIG_ZMK_RGB_UNDERGLOW=y
CONFIG_ZMK_RGB_UNDERGLOW_EXT_POWER=y
CONFIG_ZMK_RGB_UNDERGLOW_ON_START=n
CONFIG_ZMK_RGB_UNDERGLOW_EFF_START=3
CONFIG_ZMK_RGB_UNDERGLOW_BRT_START=100
CONFIG_ZMK_RGB_UNDERGLOW_BRT_MAX=100
CONFIG_WS2812_STRIP=y

# enable SPI
CONFIG_SPI=y

# USB & BLE
CONFIG_ZMK_USB=n
CONFIG_ZMK_BLE=y

# LED indicators
CONFIG_ZMK_HID_INDICATORS=y
CONFIG_LED=y

# # uncomment to enable USB logging / debugging
# CONFIG_ZMK_USB_LOGGING=y
# CONFIG_ZMK_LOG_LEVEL_DBG=y
# CONFIG_I2C_LOG_LEVEL_DBG=y
```
