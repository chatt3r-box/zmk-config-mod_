/*
 * copyright (c) 2025 ZMK project contributors
 *
 * SPDX-license-identifier: MIT
 */

#include "mod_.dtsi"
#include "modules/i2c.dtsi"
#include "modules/qdec.dtsi"
#include "modules/leds.dtsi"

&default_transform {
    row-offset = <1>;
    col-offset = <8>;
};