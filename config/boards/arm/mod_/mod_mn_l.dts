/*
 * copyright (c) 2025 ZMK project contributors
 *
 * SPDX-license-identifier: MIT
 */

#include "mod_.dtsi"
#include "modules/i2c.dtsi"
#include "modules/spi.dtsi"
#include "modules/qdec.dtsi"
#include "modules/leds.dtsi"

/ {
    /* work-around for CAPS LOCK LED indicator functionality */
    EXT_POWER {
        compatible = "zmk,ext-power-generic";
        control-gpios = <&gpio0 27 (GPIO_ACTIVE_LOW | GPIO_PULL_UP)>;
    };
};

&default_transform {
    col-offset = <2>;
};