/*
 * copyright (c) 2025 ZMK project contributors
 *
 * SPDX-license-identifier: MIT
 */

#include <dt-bindings/led/led.h>

/ {
    leds {
        compatible = "gpio-leds";
        status = "okay";
        led0: led0 {
            gpios = <&gpio0 6  (GPIO_ACTIVE_HIGH | GPIO_PULL_DOWN)>;
        };
    };
};