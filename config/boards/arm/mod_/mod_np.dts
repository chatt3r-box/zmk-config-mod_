/*
 * copyright (c) 2025 ZMK project contributors
 *
 * SPDX-license-identifier: MIT
 */

#include "mod_.dtsi"
#include "modules/spi.dtsi"

/ {
    /* work-around for NUM LOCK LED indicator functionality */
    EXT_POWER {
        compatible = "zmk,ext-power-generic";
        control-gpios = <&gpio0 26 (GPIO_ACTIVE_HIGH)>;
    };
};

&default_transform {
    col-offset = <17>;
};